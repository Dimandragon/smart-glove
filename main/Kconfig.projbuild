## main/Kconfig.projbuild
```kconfig
menu "IMU Configuration"
		
	config GPIO_RANGE_MAX
		int
		default 33 if IDF_TARGET_ESP32
		default 46 if IDF_TARGET_ESP32S2
		default 48 if IDF_TARGET_ESP32S3
		default 18 if IDF_TARGET_ESP32C2
		default 19 if IDF_TARGET_ESP32C3
		default 30 if IDF_TARGET_ESP32C6

	config GPIO_MISO1
		int "MISO1 GPIO number"
		range 0 GPIO_RANGE_MAX
		default 41 if IDF_TARGET_ESP32S2 || IDF_TARGET_ESP32S3
		help
			GPIO number (IOxx) to SPI MISO 1.

	config GPIO_MOSI1
		int "MOSI1 GPIO number"
		range 0 GPIO_RANGE_MAX
		default 42 if IDF_TARGET_ESP32S2 || IDF_TARGET_ESP32S3
		help
			GPIO number (IOxx) of SPI MOSI 1.

	config GPIO_SCLK1
		int "SPI CLK1 GPIO number"
		range 0 GPIO_RANGE_MAX
		default 1 if IDF_TARGET_ESP32S2 || IDF_TARGET_ESP32S3
		help
			GPIO number (IOxx) of SPI SCLK 1.

	config GPIO_CS1
		int "CS1 GPIO nubmer"
		range 0 GPIO_RANGE_MAX
		default 45 if IDF_TARGET_ESP32S2 || IDF_TARGET_ESP32S3
		help
			GPIO number (IOxx) of SPI CS 1.

	config GPIO_CS2
		int "CS2 GPIO nubmer"
		range 0 GPIO_RANGE_MAX
		default 48 if IDF_TARGET_ESP32S2 || IDF_TARGET_ESP32S3
		help
			GPIO number (IOxx) of SPI CS 2.

	config GPIO_CS3
		int "CS3 GPIO nubmer"
		range 0 GPIO_RANGE_MAX
		default 47 if IDF_TARGET_ESP32S2 || IDF_TARGET_ESP32S3
		help
			GPIO number (IOxx) of SPI CS 3


	config GPIO_MISO2
		int "MISO2 GPIO number"
		range 0 GPIO_RANGE_MAX
		default 39 if IDF_TARGET_ESP32S2 || IDF_TARGET_ESP32S3
		help
			GPIO number (IOxx) to SPI MISO 2.

	config GPIO_MOSI2
		int "MOSI2 GPIO number"
		range 0 GPIO_RANGE_MAX
		default 40 if IDF_TARGET_ESP32S2 || IDF_TARGET_ESP32S3
		help
			GPIO number (IOxx) of SPI MOSI 2.

	config GPIO_SCLK2
		int "SPI CLK2 GPIO number"
		range 0 GPIO_RANGE_MAX
		default 2 if IDF_TARGET_ESP32S2 || IDF_TARGET_ESP32S3
		help
			GPIO number (IOxx) of SPI SCLK 2.

	config GPIO_CS4
		int "CS4 GPIO nubmer"
		range 0 GPIO_RANGE_MAX
		default 21 if IDF_TARGET_ESP32S2 || IDF_TARGET_ESP32S3
		help
			GPIO number (IOxx) of SPI CS 4.

	config GPIO_CS5
		int "CS5 GPIO nubmer"
		range 0 GPIO_RANGE_MAX
		default 14 if IDF_TARGET_ESP32S2 || IDF_TARGET_ESP32S3
		help
			GPIO number (IOxx) of SPI CS 5.

	config GPIO_CS6
		int "CS6 GPIO nubmer"
		range 0 GPIO_RANGE_MAX
		default 13 if IDF_TARGET_ESP32S2 || IDF_TARGET_ESP32S3
		help
			GPIO number (IOxx) of SPI CS 6.

	config GPIO_INT1
		int "INT1 GPIO nubmer"
		range 0 GPIO_RANGE_MAX
		default 12 if IDF_TARGET_ESP32S2 || IDF_TARGET_ESP32S3
		help
			GPIO number (IOxx) of SPI INT 1.

	config GPIO_INT2
		int "INT1 GPIO nubmer"
		range 0 GPIO_RANGE_MAX
		default 11 if IDF_TARGET_ESP32S2 || IDF_TARGET_ESP32S3
		help
			GPIO number (IOxx) of SPI INT 2.

	config GPIO_INT3
		int "INT1 GPIO nubmer"
		range 0 GPIO_RANGE_MAX
		default 10 if IDF_TARGET_ESP32S2 || IDF_TARGET_ESP32S3
		help
			GPIO number (IOxx) of SPI INT 3.
	
	config GPIO_INT4
		int "INT1 GPIO nubmer"
		range 0 GPIO_RANGE_MAX
		default 9 if IDF_TARGET_ESP32S2 || IDF_TARGET_ESP32S3
		help
			GPIO number (IOxx) of SPI INT 4.	
			
	config GPIO_INT5
		int "INT1 GPIO nubmer"
		range 0 GPIO_RANGE_MAX
		default 46 if IDF_TARGET_ESP32S2 || IDF_TARGET_ESP32S3
		help
			GPIO number (IOxx) of SPI INT 5.
			
	config GPIO_INT6
		int "INT1 GPIO nubmer"
		range 0 GPIO_RANGE_MAX
		default 3 if IDF_TARGET_ESP32S2 || IDF_TARGET_ESP32S3
		help
			GPIO number (IOxx) of SPI INT 6.	

	config CONTROLLER_NUMBER
		int "Controller number"
		range 1 2
		default 1
		help
			controller number.
			

endmenu


menu "Net Settings"
    config MAC
        string "mac addres"
        default "D7:BB:3E:DC:B4:37"
        help
            mac addres

    config UUID
        string "unique user identificator"
        default "98e0e56d-7d76-42a5-8206-e7d44ab985e6"
        help
            unique user identificator
endmenu

menu "WIFI settings"

    config WIFI_SSID
        string "WiFi SSID"
        default "wifi"
        help
            WIFI SSID.

    config WIFI_PASSWORD
        string "WiFi password"
        default "password"
        help
            WIFI password.

    config WIFI_RECONNECT_TIMEOUT
        int "WIFI reconnect timeout"
        default 2000
        help
            WIFI reconnect timeout

    config WIFI_MAXIMUM_CONNECT_RETRY
        int "WIFI maximum connect retry count"
        default 10
        help
            WIFI maximum connect retry count

    config WIFI_SECURITY_STANDART
        int "wifi auth type: 0 = open, 1 = WEP, ..WPA_PSK, WPA2_PSK, WPA_WPA2_PSK, WPA2_ENTERPRISE, WPA3_PSK, WPA2_WPA3_PSK, OWE"
        default 3
        help
            wifi auth type
endmenu

menu "WebSocket settings"
    config WEBSOCKET_URI
        string "Websocket endpoint URI"
        default "wss://echo.websocket.events"
        help
            URL of websocket endpoint
endmenu
```
